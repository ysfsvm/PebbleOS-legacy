// SPDX-FileCopyrightText: 2026 retake
// SPDX-License-Identifier: (GPL-2.0-only OR BSD-2-Clause)

/dts-v1/;

#include "snowy.dtsi"

/ {
	model = "Pebble Time";

	compatible = "pebble,snowy", "st,stm32f439";
};
