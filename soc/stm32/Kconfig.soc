## soc/stm32/Kconfig.soc
```kconfig
# SPDX-FileCopyrightText: 2026 Brian Silvestri
# SPDX-License-Identifier: Apache-2.0

config SOC_STM32F439
    bool "ST STM32F439"
    select SOC_STM32F4
```

## subsys/bluetooth/Kconfig
```kconfig
# SPDX-FileCopyrightText: 2026 Core Devices LLC
# SPDX-License-Identifier: Apache-2.0

menu "Bluetooth"

config BT
    bool "Bluetooth"
    select BTUTIL
    select MBEDTLS
    select TASK_WDT
    help
      The Bluetooth subsystem: the NimBLE host and the PebbleOS glue
      around it.

if BT

config BT_VENDOR_ID
    hex "Vendor ID"
    default 0x0EEA
    help
      Company identifier in the manufacturer data of advertisements.

config BT_VENDOR_NAME
    string "Vendor name"
    default "Core Devices LLC"
    help
      Manufacturer name in the Device Information Service.

config BT_HOST_THREAD_STACK_SIZE
    int "Host thread stack size in bytes"
    default 5000

config BT_HOST_THREAD_PRIO
    int "Host thread priority"
    default 3

config BT_LL_THREAD_STACK_SIZE
    int "Link layer thread stack size in bytes"
    default 1384

config BT_LL_THREAD_PRIO
    int "Link layer thread priority"
    default 4

config BT_HCI_THREAD_STACK_SIZE
    int "HCI transport thread stack size in bytes"
    default 1024

config BT_HCI_THREAD_PRIO
    int "HCI transport thread priority"
    default 3

choice BT_HCI
    prompt "HCI transport"
    default BT_HCI_FAKE
    help
      How the NimBLE host reaches its controller. The default is derived
      from the SoC (see each soc/<soc>/Kconfig.defconfig); the fake
      controller is the fallback where there is no radio.

config BT_HCI_NRF52
    bool "NimBLE controller on the nRF52 radio"
    depends on SOC_NRF52
    select NIMBLE_CONTROLLER
    select NIMBLE_DRIVER_NRF5X
    help
      Run the NimBLE link layer in the same image, on the nRF52 radio.

config BT_HCI_SF32LB52
    bool "SiFli LCPU over IPC"
    depends on SOC_SF32LB52
    select REMOTEPROC
    help
      Talk H4 HCI to the SiFli controller running on the LCPU, over the
      byte rings its ROM shares with the HCPU.

config BT_HCI_UART
    bool "H4 over UART"
    depends on QEMU || SOC_POSIX || SOC_STM32F4
    help
      Talk H4 HCI to an external controller over the board's BT_HCI_UART.
      On QEMU this is the fourth serial port, on native boards the -b
      option; either can be attached to a host controller such as an
      nRF52840 dongle running Zephyr's hci_uart.

config BT_HCI_FAKE
    bool "Fake controller"
    help
      Answer every HCI command locally with success and never raise an
      event. The host synchronises and the GATT server runs, but no link
      can be established. For targets without a radio, such as QEMU.

endchoice

config BT_HCI_UART_LEGACY
    bool
    depends on BT_HCI_UART
    default y if BT_CONTROLLER_CC2564
    help
      The legacy watches' H4 transport (transport/hci_uart_legacy.c in
      NimBLE's glue) in place of Core's: it boots and sets up the
      controller, runs its low-power UART protocol, puts the pinned
      resolvable private address in, and recovers a wedged controller.
      It drives the board's STM32 USART BOARD_BT_HCI_UART_DEV itself;
      the BT_HCI_UART role is not used.

config BT_OWN_SERVICE_CHANGED
    bool "Service Changed with a reconnect"
    default y if BT_CONTROLLER_CC2564
    help
      Indicate Service Changed after pairing, after an update that changed
      the attribute layout and after importing the stock pairing, then
      drop the link so the phone app reconnects with the new layout. The
      watches that share the filesystem with the stock firmware need it:
      phones keep the stock firmware's attribute cache otherwise.

choice BT_ID_ADDR_SOURCE
    prompt "Identity address"
    default BT_ID_ADDR_CONTROLLER
    help
      Where the watch's Bluetooth identity address comes from. The default
      is derived from the SoC (see each soc/<soc>/Kconfig.defconfig).

config BT_ID_ADDR_CONTROLLER
    bool "Controller"
    help
      Use the address the controller reports, or let NimBLE pick one.

config BT_ID_ADDR_SF32LB52_EFUSE
    bool "SF32LB52 eFUSE"
    depends on NVMEM_SF32LB52
    select BT_ID_ADDR
    help
      Public address derived from the unique ID in the SoC's eFUSE.

config BT_ID_ADDR_SERIAL
    bool "Random static address from the serial number"
    select BT_ID_ADDR
    help
      Derive a random static address from the watch's serial number on every
      boot, as the legacy DA14681 firmware did. It needs no storage, so it
      never changes, and matches the address the legacy firmware used.

config BT_ID_ADDR_STORAGE
    bool "Stored random static address"
    depends on SERVICE_SHARED_PRF_STORAGE
    select BT_ID_ADDR
    help
      Generate a random static address once and keep it in shared PRF
      storage, for controllers without an address of their own.

endchoice

config BT_ID_ADDR
    bool
    help
      An identity address backend is selected (pbl/bluetooth/id_addr.h).

config BT_ID_ADDR_PREFER_PUBLIC
    bool "Prefer the controller's public address"
    depends on BT_ID_ADDR
    help
      Use the public address the controller reports, when it has one, and
      the identity address source above only when it reports none. For
      controllers that some units ship with a factory address and others
      not.

module = BT
module-str = Bluetooth
source "subsys/logging/Kconfig.template.log_level"

config BT_REPEAT_PAIRING_ALWAYS
    bool "Always accept repeat pairing"
    help
      Forget the keys of a bonded peer that pairs again and accept it, even
      without secure connections and user confirmation. For firmware with
      no other way to forget a pairing.

config BT_HRM_SERVICE
    bool
    help
      The backend implements the Heart Rate Service
      (pbl/bluetooth/hrm_service.h).

rsource "services/Kconfig"

endif

endmenu
```

## subsys/fs/Kconfig
```kconfig
# SPDX-FileCopyrightText: 2026 Core Devices LLC
# SPDX-License-Identifier: Apache-2.0

menuconfig FS
    bool "File system"
    select TASK_WDT
    help
      Access to files on mounted file systems, regardless of their
      format.

if FS

config FS_PFS
    bool "Pebble File System (PFS)"
    select CRC
    default y
    help
      PFS, the wear-leveled file system on the external NOR flash.

config FS_PFS_PAGE_SIZE
    hex "PFS page size"
    depends on FS_PFS && FLASH_S29VS
    default 0x2000
    help
      Size of a PFS page, a fraction of the erase sector. The S29VS has
      8 KiB pages in its 128 KiB sectors, as in the stock firmware.
      Without it, a page is the flash subsector.

config FS_PFS_FORMAT_SECTOR_PAGES
    bool "Format a PFS written with one page per erase sector"
    depends on FS_PFS
    default y if FLASH_S29VS
    help
      At boot, format the filesystem when its page headers sit only at
      erase sector starts: it was written by a firmware whose page was
      the whole erase sector, and smaller pages cannot read its files.

config FS_PFS_CONVERT_SECTOR_PAGES
    bool "Convert a PFS written with one page per erase sector"
    depends on FS_PFS_FORMAT_SECTOR_PAGES
    help
      Instead of formatting such a filesystem, convert it at boot to the
      smaller pages, keeping its files. A conversion cut by a reset
      resumes at the next boot.

config FS_PFS_SHELL_LITTER
    bool "PFS litter shell command"
    depends on FS_PFS && SHELL
    help
      The pfs litter command, to fragment the file system for testing.

module = FS
module-str = File system
source "subsys/logging/Kconfig.template.log_level"

endif
```

## subsys/task_wdt/Kconfig
```kconfig
# SPDX-FileCopyrightText: 2026 Core Devices LLC
# SPDX-License-Identifier: Apache-2.0

menuconfig TASK_WDT
    bool "Task watchdog"
    default y if WATCHDOG
    help
      Software watchdog that catches stuck threads, and the one feeding
      the hardware watchdog: without it, a hardware watchdog the SoC has
      started resets the system.

if TASK_WDT

config TASK_WDT_CHANNELS
    int "Channels"
    range 1 8
    default 8
    help
      Threads the task watchdog can watch at once.

config TASK_WDT_TIMEOUT_MS
    int "System thread timeout in milliseconds"
    default 5000
    help
      Timeout the system threads (KernelMain, SysWorkq, SysWorkqHigh)
      register their channels with.

config TASK_WDT_CHECK_PERIOD_MS
    int "Check period in milliseconds"
    default 3000 if WATCHDOG && WATCHDOG_TIMEOUT_MS < 20000
    default 10000
    help
      How often the watchdog thread checks its channels and feeds the
      hardware watchdog, waking the system up to do so. Must stay below
      half of the hardware watchdog timeout.

config TASK_WDT_GRACE_MS
    int "Grace period in milliseconds"
    default 1000
    help
      How long a channel may stay expired after a check first finds it
      expired, with its callback running on every check, before the
      system resets with a core dump. While a channel is expired, the
      checks run at most this far apart.

config TASK_WDT_THREAD_PRIO
    int "Watchdog thread priority"
    default 4

config TASK_WDT_THREAD_STACK_SIZE
    int "Watchdog thread stack size in bytes"
    default 1536
    help
      The expiry path logs synchronously and runs the channel callbacks
      on this stack; the QEMU build uses about 700 bytes of it there.

config TASK_WDT_HARDLOCKUP
    bool "Hard lockup detector"
    depends on ARCH_HAS_HARDLOCKUP_DETECTOR && WATCHDOG
    help
      Write a core dump when an interrupt handler or a thread with the
      kernel's interrupts locked starves the watchdog thread, instead of
      leaving the hardware watchdog to reset without one. A timer that
      the interrupt lock does not mask counts the time the CPU runs,
      outside idle waits and deep sleep, since the watchdog thread last
      ran; it interrupts the CPU at least sixteen times per timeout while
      it runs.

      A board that turns it on gives the condition too, as with
      "default y if ARCH_HAS_HARDLOCKUP_DETECTOR": a default set in
      another file is not bound by the dependencies above.

config TASK_WDT_HARDLOCKUP_TIMEOUT_MS
    int "Hard lockup timeout in milliseconds"
    depends on TASK_WDT_HARDLOCKUP
    default 4500 if WATCHDOG_STM32
    default 6000 if WATCHDOG_TIMEOUT_MS < 20000
    default 20000
    help
      Time the CPU runs without the watchdog thread running after which
      a hard lockup is reported, never sooner, and at most an eighth
      later. Above the check and grace periods; with that eighth, below
      TASK_WDT_HARDLOCKUP_WATCHDOG_MIN_MS.

config TASK_WDT_HARDLOCKUP_WATCHDOG_MIN_MS
    int "Shortest hardware watchdog timeout in milliseconds"
    depends on TASK_WDT_HARDLOCKUP
    default 5500 if WATCHDOG_STM32
    default WATCHDOG_TIMEOUT_MS
    help
      The hardware watchdog's timeout with its clock at the fast end of
      its tolerance; the detector's timeout is checked against it. The
      STM32F4 IWDG counts 4096 periods of the LSI divided by 64, 8.2 s at
      the nominal 32 kHz, but the LSI may run at up to 47 kHz: 5.6 s.

module = TASK_WDT
module-str = Task watchdog
source "subsys/logging/Kconfig.template.log_level"

endif
```

## third_party/hal_stm32/Kconfig
```kconfig
# SPDX-FileCopyrightText: 2026 Brian Silvestri
# SPDX-License-Identifier: Apache-2.0

menuconfig HAL_STM32
    bool "STM32 Standard Peripheral Library"
    select CMSIS_CORE
    help
      Build the STM32F4xx Standard Peripheral Library.

if HAL_STM32

config HAL_STM32_STM32F439
    bool
    default y if SOC_STM32F439
    help
      Configure the library for the STM32F439 used by the Pebble Time
      (snowy).

endif # HAL_STM32
```
