## drivers/exti/Kconfig
```kconfig
# SPDX-FileCopyrightText: 2026 Core Devices LLC
# SPDX-License-Identifier: Apache-2.0

menuconfig EXTI
    bool "External Interrupt"
    help
      External Interrupt Drivers

if EXTI

config EXTI_STM32
    bool "ST STM32"
    default y if SOC_STM32F4
    depends on GPIO_STM32
    help
      The stock firmware's EXTI calls, on the interrupt controllers of the
      STM32F4 GPIO ports.

module = DRIVER_EXTI
module-str = External Interrupt
source "subsys/logging/Kconfig.template.log_level"

endif # EXTI
```

## drivers/flash/Kconfig
```kconfig
# SPDX-FileCopyrightText: 2026 Core Devices LLC
# SPDX-License-Identifier: Apache-2.0

menuconfig FLASH
    bool "Flash"
    select CRC
    select TASK_WDT
    help
      Flash Drivers

if FLASH

config FLASH_OTP
    bool
    help
      Selected by drivers with a user one-time programmable area, see
      pbl_flash_otp_*().

config FLASH_SPI_NOR
    bool "SPI NOR"
    default DT_HAS_JEDEC_SPI_NOR_ENABLED
    select SPI_MEM
    select FLASH_OTP
    help
      Support for a JEDEC NOR flash on a SPI memory controller, found by
      its JEDEC ID among the supported parts and described by its SFDP
      tables and the part description.

config FLASH_S29VS
    bool "Spansion S29VS (FMC)"
    depends on HAL_STM32_STM32F439
    help
      Support for the Spansion S29VS parallel NOR flash on the STM32F439
      FMC, as found on the Pebble Time (snowy).

config FLASH_QEMU
    bool "QEMU External Flash"
    default DT_HAS_QEMU_PEBBLE_EXTFLASH_ENABLED
    depends on SOC_QEMU_PEBBLE
    help
      Support for the QEMU external flash peripheral.

config FLASH_POSIX
    bool "POSIX External Flash"
    default y if SOC_POSIX
    help
      External flash backed by a file on the host.

config FLASH_SHELL
    bool "Shell commands"
    default DRIVER_SHELL
    depends on SHELL
    help
      The flash shell command, to inspect, erase and test the flash.

config FLASH_SHELL_TEST
    bool "Test commands"
    depends on FLASH_SHELL
    help
      The flash read, fill, validate and erased_sectors commands, to dump
      and verify the flash from a host.

config FLASH_SHELL_STRESS
    bool "Stress and benchmark commands"
    default y
    depends on FLASH_SHELL
    help
      The flash stress and benchmark commands. The stress test writes the
      firmware update area.

config FLASH_LAYOUT_SNOWY
    bool "Pebble Time (snowy, spalding) stock flash layout"
    select FLASH_GUARD
    help
      Use the stock Pebble Time and Time Round external flash layout, keeping the stock
      bootloader's PRF, shared PRF storage and MFG info (with the boot FPGA
      bitstream) where they are.

config FLASH_GUARD
    bool "Guard regions the firmware does not own"
    help
      Refuse any erase or write that overlaps PRF, stock shared PRF
      storage or MFG info.

module = DRIVER_FLASH
module-str = Flash
source "subsys/logging/Kconfig.template.log_level"

endif # FLASH
```

## drivers/input/Kconfig
```kconfig
# SPDX-FileCopyrightText: 2026 Core Devices LLC
# SPDX-License-Identifier: Apache-2.0

menu "Input"

config INPUT_GPIO_KEYS
    bool "GPIO keys"
    default DT_HAS_GPIO_KEYS_ENABLED
    depends on INPUT
    select GPIO
    help
      Keys on GPIOs with interrupts, debounced in software.

config INPUT_STM32_KEYS
    bool "STM32 keys"
    depends on INPUT && EXTI
    select HAL_STM32
    help
      Keys on STM32F4 GPIOs, debounced by sampling them with TIM4 as the
      stock firmware does.

config INPUT_SDL
    bool "SDL keyboard"
    default y if SOC_POSIX
    depends on INPUT
    select SDL
    help
      Watch buttons driven by the keyboard, through SDL, in a native build.

endmenu
```

## drivers/otp/Kconfig
```kconfig
# SPDX-FileCopyrightText: 2026 Core Devices LLC
# SPDX-License-Identifier: Apache-2.0

menuconfig OTP
    bool "OTP Storage"
    help
      One-Time Programmable storage for serial numbers, HW revision, etc.

if OTP

config OTP_FLASH
    bool "Flash security registers"
    default y
    depends on FLASH_OTP
    help
      OTP slots in the cells the board lays out in the flash OTP area
      (security registers on SPI NOR parts). Driver: otp_flash.c.

config OTP_STM32
    bool "STM32 OTP area"
    default y if SOC_STM32F4
    help
      OTP backed by the STM32F4 one-time programmable area. Read-only:
      writes are always refused.

config OTP_QEMU
    bool "QEMU"
    default y if SOC_QEMU_PEBBLE
    help
      QEMU OTP. QEMU emulates none, so all slots read as locked and empty.

config OTP_POSIX
    bool "POSIX"
    default y if SOC_POSIX
    help
      No OTP on the host: all slots read as locked and empty.

endif # OTP
```

## drivers/pinctrl/Kconfig
```kconfig
# SPDX-FileCopyrightText: 2026 Core Devices LLC
# SPDX-License-Identifier: Apache-2.0

menuconfig PINCTRL
    bool "Pin controllers"
    help
      Pin controller class (pbl/drivers/pinctrl.h), selected by the drivers
      that route peripheral signals to pins.

if PINCTRL

config PINCTRL_SF32LB52
    bool "SiFli SF32LB52 pin controller"
    default DT_HAS_SIFLI_SF32LB52_PINCTRL_ENABLED
    help
      Pin multiplexer and pad configuration of the SiFli SF32LB52 HPSYS
      pads.

config PINCTRL_SF32LB52_OUTPUT_LOW
    bool
    depends on PINCTRL_SF32LB52
    help
      Pins of a state can be driven low, through the GPIO driver.

config PINCTRL_STM32
    bool "ST STM32F4 pin controller"
    default DT_HAS_ST_STM32F429_PINCTRL_ENABLED
    depends on GPIO_STM32
    help
      Alternate functions and pad configuration of the STM32F4 GPIO
      ports.

config PINCTRL_SHELL
    bool "Pin controller shell commands"
    default DRIVER_SHELL
    depends on SHELL
    help
      The pinctrl shell command, to dump the pad registers of every pin
      controller.

endif # PINCTRL
```

## drivers/pmic/Kconfig
```kconfig
# SPDX-FileCopyrightText: 2026 Core Devices LLC
# SPDX-License-Identifier: Apache-2.0

menuconfig PMIC
    bool "PMIC"
    help
      PMIC Drivers

if PMIC

config PMIC_NPM1300
    bool "Nordic nPM1300 charger"
    default DT_HAS_NORDIC_NPM1300_ENABLED
    select BATTERY_HIGH_LOAD
    select MFD
    select MFD_NPM1300
    help
      Support for the charger of the Nordic nPM1300 PMIC.

config PMIC_MAX14690
    bool "Maxim MAX14690"
    depends on SOC_STM32F4 && I2C
    help
      Support for the Maxim MAX14690 PMIC on snowy: charger, LDO2 for the
      display FPGA and battery voltage measurement through its MON output.
      Charger settings are the stock firmware's.

module = DRIVER_PMIC
module-str = PMIC
source "subsys/logging/Kconfig.template.log_level"

endif # PMIC
```

## drivers/spi/Kconfig
```kconfig
# SPDX-FileCopyrightText: 2026 Core Devices LLC
# SPDX-License-Identifier: Apache-2.0

menuconfig SPI
    bool "SPI"
    help
      SPI Drivers

if SPI

config SPI_NRF5
    bool "Nordic nRF5 SPI Controller"
    default DT_HAS_NORDIC_NRF52832_SPIM_ENABLED
    depends on SOC_NRF52
    help
      Support for the Nordic nRF5 SPIM controller.

config SPI_NRF5_IRQ_PRIO
    int "Interrupt priority"
    default 7
    depends on SPI_NRF5
    help
      Priority of the controller interrupts.

config SPI_STM32
    bool "ST STM32F4 SPI Controller"
    default DT_HAS_ST_STM32F4_SPI_ENABLED
    depends on SOC_STM32F4
    select RESET
    help
      Support for the STM32F4 SPI block in master mode, polled.

config SPI_STM32_STATS
    bool "Count transfers"
    depends on SPI_STM32
    help
      Count the transfers of all buses and keep the longest one, for
      pbl_spi_stm32_stats().

config SPI_SHELL
    bool "Shell commands"
    default DRIVER_SHELL
    depends on SHELL
    help
      The spi shell command, to list the buses and run transfers.

module = DRIVER_SPI
module-str = SPI
source "subsys/logging/Kconfig.template.log_level"

endif # SPI
```

## drivers/timer/Kconfig
```kconfig
# SPDX-FileCopyrightText: 2026 Core Devices LLC
# SPDX-License-Identifier: Apache-2.0

menu "System timer"

config TIMER_ARM_SYSTICK
    bool "Arm SysTick"
    depends on CPU_CORTEX_M
    help
      Clock event device on the Arm SysTick timer, counting CPU cycles. It
      stops in deep sleep.

config TIMER_QEMU
    bool "QEMU"
    help
      Clock source on the 1 kHz counter of the QEMU RTC.

config TIMER_NRF5_RTC
    bool "Nordic nRF5 RTC"
    select CLK
    help
      Clock source and clock event device on RTC1, counting the 32.768 kHz
      low-frequency clock. It keeps running in every sleep mode.

config TIMER_SF32LB_LPTIM
    bool "SiFli SF32LB LPTIM"
    select CLK
    help
      Clock source and clock event device on LPTIM1, counting clk_rtc, the
      calibrated LRC10 or the 32 kHz crystal. It keeps running and wakes the
      CPU up in deep sleep.

config TIMER_STM32_RTC
    bool "STM32F4 RTC"
    help
      Clock source and clock event device on the STM32F4 RTC: the calendar
      and its 256 Hz sub-second counter. Alarm A or the wakeup timer raises
      the clock events; both keep running and wake the CPU up in STOP mode.

config TIMER_STM32_RTC_WUT
    bool "STM32F4 RTC wakeup timer as the clock event"
    depends on TIMER_STM32_RTC
    help
      Raise the kernel's clock events with the RTC wakeup timer, in steps
      of 61 us. The kernel sets it up again on most ticks, with interrupts
      locked for about 60 us each time. With it on, snowy loses bytes of
      the CC2564's init script replies when Bluetooth is restarted. Off,
      alarm A raises the events (SysTick on the emulated SoC, which then
      cannot use STOP).

config TIMER_STM32_RTC_ALARM
    bool "STM32F4 RTC alarm A as the clock event"
    depends on TIMER_STM32_RTC && !TIMER_STM32_RTC_WUT && !SOC_STM32F4_EMULATED
    default y
    help
      Raise the kernel's clock events with alarm A and its sub-second
      match, in steps of the 256 Hz clock source; an event is at least
      three steps (11.7 ms) away. The emulator does not model the
      sub-second match.

config TIMER_STM32_RTC_WUT_PERIODIC
    bool "Leave the wakeup timer running between events of the same period"
    depends on TIMER_STM32_RTC_WUT
    default y
    help
      The kernel asks for an event every tick. Off, each request stops the
      timer and writes it again, which takes about 60 us with interrupts
      locked.

config TIMER_STM32_RTC_WUT_MIN_COUNT
    int "Shortest clock event, in wakeup timer counts (1/16384 s)"
    depends on TIMER_STM32_RTC_WUT
    default 16
    help
      16 is one kernel tick at 1024 Hz; 64 is one step of the 256 Hz clock
      source, below which the kernel sees no time pass.

config TIMER_POSIX
    bool "POSIX"
    help
      Clock source and clock event device on the host monotonic clock.

endmenu
```

## dts/bindings/arm/pebble.yaml
```yaml
# SPDX-License-Identifier: (GPL-2.0-only OR BSD-2-Clause)
%YAML 1.2
---
$id: http://devicetree.org/schemas/arm/pebble.yaml#
$schema: http://devicetree.org/meta-schemas/core.yaml#

title: Pebble Technology watches on STM32F4

maintainers:
  - retake <ysfss@protonmail.com>

properties:
  $nodename:
    const: "/"
  compatible:
    oneOf:
      - description: Pebble Time and Time Steel (snowy)
        items:
          - const: pebble,snowy
          - const: st,stm32f439
      - description: Pebble Time Round (spalding)
        items:
          - const: pebble,spalding
          - const: st,stm32f439

additionalProperties: true
```

## dts/bindings/input/pebble,pwm-hbridge-vibrator.yaml
```yaml
# SPDX-FileCopyrightText: 2026 Yusuf Sevim
# SPDX-License-Identifier: (GPL-2.0-only OR BSD-2-Clause)
%YAML 1.2
---
$id: http://devicetree.org/schemas/input/pebble,pwm-hbridge-vibrator.yaml#
$schema: http://devicetree.org/meta-schemas/core.yaml#

title: Vibration motor on an H-bridge driven by one PWM channel

maintainers:
  - retake <ysfss@protonmail.com>

description: >
  A motor across an H-bridge whose two sides one PWM channel drives in
  opposition: a 50% duty cycle stops the motor, higher duty cycles run it
  forward, up to full strength at 100%, and lower ones backwards, which
  brakes it. pwm-vibrator expects 0% to stop the motor instead.

properties:
  compatible:
    const: pebble,pwm-hbridge-vibrator

  pwms:
    maxItems: 1

  pwm-names:
    items:
      - const: enable

  enable-gpios:
    maxItems: 1
    description: Enables the H-bridge while the motor runs.

required:
  - compatible
  - pwms

additionalProperties: false

examples:
  - |
    #include <dt-bindings/gpio/gpio.h>

    vibrator {
        compatible = "pebble,pwm-hbridge-vibrator";
        pwms = <&pwm10 0 45454 0>;
        pwm-names = "enable";
        enable-gpios = <&gpiof 4 GPIO_ACTIVE_HIGH>;
    };
```

## pebble/services/app_glances/Kconfig
```kconfig
# SPDX-FileCopyrightText: 2026 Core Devices LLC
# SPDX-License-Identifier: Apache-2.0

config SERVICE_APP_GLANCES
    bool "App glances"
    help
      App-glances (launcher tile) service.

config APP_GLANCE_ON_DEMAND
    bool "Allocate the app glance only while it is reloaded"
    help
      Keep an app's glance (over 1 KiB) in its heap only while
      app_glance_reload() runs, instead of in the app state for the whole
      life of the app. For boards whose app state is otherwise too large
      for the app runtime of their platform. A reload that finds no memory
      logs an error and leaves the glance as it was.
```

## pebble/services/get_bytes/Kconfig
```kconfig
# SPDX-FileCopyrightText: 2026 Core Devices LLC
# SPDX-License-Identifier: Apache-2.0

config SERVICE_GET_BYTES
    bool "Get bytes"
    help
      get_bytes endpoint (file/flash/coredump retrieval).

if SERVICE_GET_BYTES

module = SERVICE_GET_BYTES
module-str = Get bytes
source "subsys/logging/Kconfig.template.log_level"

config SERVICE_GET_BYTES_RAW
    bool "File and flash retrieval"
    default y if !RELEASE
    help
      Serve files and raw flash, including pairing keys, to the connected
      phone. Off in release builds unless a debug image asks for it.

endif
```

## pebble/services/imaging/Kconfig
```kconfig
# SPDX-FileCopyrightText: 2026 Brian Silvestri
# SPDX-License-Identifier: Apache-2.0

config SERVICE_IMAGING_PICTURES
    bool "Album art and notification pictures"
    depends on PLATFORM_COLOR
    default y if PLATFORM_EMERY || PLATFORM_GABBRO
    help
      Show album art in the music app and pictures in notifications, fetched
      from the phone through the imaging endpoint at the watch's size, 4 bits
      per pixel. Needs a color display, and room in the kernel heap for one
      decoded image at a time; an image that does not fit is dropped and the
      text-only layout shown.

config SERVICE_IMAGING_ALBUM_ART_APP_HEAP
    bool "Keep album art in the Music app's heap"
    depends on SERVICE_IMAGING_PICTURES
    help
      Copy the album art into the Music app's heap as soon as it arrives and
      free the kernel copy, and drop art that arrives while the app is closed.
      For boards whose kernel heap cannot hold a cover all the time.
```

## pebble/services/shared_prf_storage/Kconfig
```kconfig
# SPDX-FileCopyrightText: 2026 Core Devices LLC
# SPDX-License-Identifier: Apache-2.0

config SERVICE_SHARED_PRF_STORAGE
    bool "Shared PRF storage"
    help
      Shared storage used by the PRF (recovery) firmware.

if SERVICE_SHARED_PRF_STORAGE

config SERVICE_SHARED_PRF_STORAGE_IMPORT_STOCK_V2
    bool "Import the stock firmware's v2 shared PRF storage"
    depends on BT
    help
      On boards whose recovery firmware is the stock one, which keeps its own
      shared PRF storage in the older v2 layout (snowy): one struct at the
      start of PART_STOCK_SHARED_PRF_STORAGE, with Bluetopia's legacy pairing
      keys. Copy its root keys, name and pairing into this firmware's storage
      when the identity root key differs from it, so the phone sees one watch
      in both firmwares. The stock region is only read.

module = SERVICE_SHARED_PRF_STORAGE
module-str = Shared PRF storage
source "subsys/logging/Kconfig.template.log_level"

endif
```
