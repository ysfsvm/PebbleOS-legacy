## Kconfig.legacy
```kconfig
# SPDX-FileCopyrightText: 2026 retake
# SPDX-License-Identifier: Apache-2.0

# Changes the legacy watches make to code Core's own boards share. The
# legacy boards select LEGACY_WATCH; without it every option here keeps
# Core's behaviour.

config LEGACY_WATCH
    bool
    help
      The board is a legacy Pebble watch (Pebble Time, Time Steel, Time
      Round, Pebble 2), outside Core's own range.

menu "Legacy watch changes to shared code"
    depends on LEGACY_WATCH

config LEGACY_BT_PASSKEY_DISPLAY
    bool "LE legacy pairing with a displayed passkey"
    default y
    help
      Answer a passkey display request (LE legacy pairing, as with
      controllers without Secure Connections) with a random passkey for
      the user to type on the phone, and end pairing on actions the watch
      cannot answer. Let a bonded phone pair again while the watch is
      pairable, so keys that no longer match (e.g. after pairing in the
      stock recovery firmware) can be replaced; refuse it otherwise.

config LEGACY_BT_NAME_ON_FIRST_PAIRING
    bool "Keep the phone's name on the first pairing"
    default y
    help
      Store the phone's name read before the bonding existed, and find the
      connection by its resolved identity address when the read completes.

config LEGACY_BT_HOST_RESET_RECOVERY
    bool "Restore the address after a host reset"
    default y
    help
      Set the identity address again when the NimBLE host resets and
      resyncs, and log repeated host resets and advertising attempts
      without an address as a count.

config LEGACY_BT_STOCK_PAIRINGS
    bool "Delete the stock firmware's pairings"
    default y if BT_CONTROLLER_CC2564
    help
      Let the pairings the stock firmware of the CC2564 watches stored, in
      a shorter record layout, be deleted from the settings.

config LEGACY_BT_CONTROLLER_OFF_WHEN_STOPPED
    bool "Hold the Bluetooth controller in shutdown while Bluetooth is off"
    depends on BT_CONTROLLER_CC2564
    default y
    help
      In airplane mode and while the watch lies still (stationary mode) the
      host stops; hold the CC2564 in shutdown then, about 1 uA instead of
      tens in deep sleep, and boot it with its init script (about a second)
      when Bluetooth comes back on.

config LEGACY_ECOMPASS_RTC_CAL
    bool "Keep the compass calibration across restarts"
    depends on SOC_STM32F4 && MAG
    default y
    help
      Keep the compass calibration in the RTC backup registers, as the
      stock firmware did (same registers and layout), so a restart does not
      throw it away: it lasts until the battery runs out or a charger is
      plugged in (which resets it, as before).

config LEGACY_EMOJI_PACK
    bool "Full emoji set from a pack file"
    help
      The board's resource bank holds only a subset of the colour emoji.
      Draw from the /emoji file when it is installed: a resource pack with
      the full emoji fonts that the board's resource map declares as the
      emoji fonts' extensions. The bank's subset serves what the pack
      misses, and everything without the pack.

config LEGACY_FACTORY_RESET_KEEPS_FIRMWARE
    bool "Factory reset wipes the filesystem but keeps the firmware"
    depends on SOC_STM32F4
    help
      Core's factory reset boots the recovery firmware after the wipe, as
      the stock firmware did. On these watches the recovery firmware is
      the stock one and the phone app then installs the stock firmware
      over it, so a factory reset would also undo this firmware. Keep the
      firmware and wipe the filesystem only; a reset during the wipe
      finishes it at the next boot (RTC backup register).

config LEGACY_LANG_PACK_STOCK_LAYOUT
    bool "Read language packs built for the stock firmware"
    default y
    help
      Language packs built for the stock firmware (the community packs the
      phone app offers where Core has none) hold 19 resources, without the
      two Gothic 36 extensions and the LECO fonts Core's layout adds. Read
      their Bitham, Roboto and Droid fonts from where they are, instead of
      two entries off.

config LEGACY_VOICE_ENCODER_IDLE_FREE
    bool "Free the voice encoder between sessions"
    default y
    help
      Give the Speex encoder's kernel heap (over 8 KB) back when a
      dictation or app microphone session ends, instead of keeping it
      from the first session on.

config LEGACY_ASSERT_CALLER_LR
    bool "libc assert() records its caller"
    default y
    help
      Record the caller of a failed libc assert() as the reboot reason's
      address, rather than assert() itself.

endmenu

config BT_LE_IDLE_SLAVE_LATENCY
    int "Slave latency while idle"
    default 30 if LEGACY_WATCH
    default 4
    help
      Connection events the watch may skip at the slow response time
      (and at the middle one, unless BT_LE_MIDDLE_SLAVE_LATENCY says
      otherwise).

config BT_LE_MIDDLE_SLAVE_LATENCY
    int "Slave latency at the middle response time"
    default 2 if LEGACY_WATCH
    default BT_LE_IDLE_SLAVE_LATENCY
    help
      Connection events the watch may skip at the middle response time,
      which music control, file transfers and apps asking for a reduced
      sniff interval request. The stock firmware used 2; at the idle
      latency of the legacy boards (30) each phone message waited up to
      about a second.

config BT_LE_IDLE_INTERVAL_MIN
    int "Minimum connection interval while idle (1.25 ms units)"
    default 24 if LEGACY_WATCH
    default 36

config BT_LE_IDLE_INTERVAL_MAX
    int "Maximum connection interval while idle (1.25 ms units)"
    default 36 if LEGACY_WATCH
    default 48

config LEGACY_HARDLOCKUP_TEST
    bool "Lock up a minute after boot (test of the hard lockup detector)"
    depends on TASK_WDT_HARDLOCKUP && COREDUMP && SOC_STM32F4
    help
      For testing only. A minute after boot, spin on the system work
      queue with the kernel's interrupts locked, which starves the
      watchdog thread, unless an unread core dump is stored: the detector
      writes one, so the watch then boots normally until it is read.

      It does not lock up on the boot after a crash or a hardware
      watchdog reset, whatever the detector did, nor while a firmware
      update runs. Each lockup, and a hardware watchdog reset if the
      detector fails, is a failed boot for the stock bootloader, which
      starts the recovery firmware at the third without 15 minutes of
      running in between: let the watch run 15 minutes after a test.
```

## boards/spalding/Kconfig
```kconfig
# SPDX-FileCopyrightText: 2026 Brian Silvestri
# SPDX-License-Identifier: Apache-2.0

config BOARD_SPALDING
    bool
    default y
    select LEGACY_WATCH
    select BOARD_PARTITIONS_SNOWY
```

## drivers/als/Kconfig
```kconfig
# SPDX-FileCopyrightText: 2026 Core Devices LLC
# SPDX-License-Identifier: Apache-2.0

menuconfig ALS
    bool "Ambient Light Sensor"
    help
      Ambient light sensor drivers (pbl/drivers/als.h). The board
      instantiates the sensor it has and exports it as ALS.

if ALS

config ALS_OPT3001
    bool "TI OPT3001"
    default DT_HAS_TI_OPT3001_ENABLED
    select I2C
    help
      Support for the TI OPT3001 ambient light sensor.

config ALS_OPT3001_ALWAYS_ON
    bool "Convert continuously"
    depends on ALS_OPT3001
    help
      Keep converting instead of converting once per read, for faster reads
      at the cost of power.

config ALS_W1160
    bool "Sensortek W1160"
    default DT_HAS_SENSORTEK_W1160_ENABLED
    select I2C
    select REGULATOR
    help
      Support for the Sensortek W1160 ambient light sensor.

config ALS_STM32_ADC
    bool "Analog sensor on the STM32 ADC"
    depends on SOC_STM32F4
    help
      Light sensor read through ADC1 against VREFINT, powered by a GPIO.

config ALS_THRESHOLD_LOCAL
    bool "Keep the dark threshold off the phone sync"
    help
      Do not sync the backlight's ambient light threshold with the phone,
      and drop a stored one once. For sensors whose scale differs a lot
      from other watches (the original Pebble's reads ~235 in the dark), so
      a value synced from another watch model cannot keep the backlight off.

config ALS_LUX_TABLE
    bool "Convert levels to lux with a board table"
    depends on ALS_STM32_ADC
    help
      Convert raw levels to lux by interpolating between calibration points
      in the sensor's pbl_als_scale table, for a sensor whose response
      is far from linear (a phototransistor that flattens out in bright
      light), instead of the linear offset/num/den conversion.

config ALS_SIM
    bool "Simulator"
    default y if SOC_QEMU_PEBBLE || SOC_POSIX
    help
      Simulated ambient light sensor, reading a level set through its
      simulator API (pbl/drivers/als/sim.h).

config ALS_BITS
    int "Ambient light sensor resolution (bits)"
    default 12 if ALS_OPT3001
    default 16 if ALS_W1160
    default 12 if ALS_SIM
    default 12 if ALS_STM32_ADC
    help
      Number of bits in the ambient light sensor reading. Used to derive
      PBL_ALS_LEVEL_MAX, which bounds the dark/backlight thresholds
      exposed to the shell and settings UI.

module = DRIVER_ALS
module-str = Ambient Light Sensor
source "subsys/logging/Kconfig.template.log_level"

endif # ALS
```

## drivers/bluetooth/Kconfig
```kconfig
# SPDX-FileCopyrightText: 2026 Brian Silvestri
# SPDX-License-Identifier: Apache-2.0

config BT_CONTROLLER_CC2564
    bool "TI CC2564 controller"
    depends on SOC_STM32F4 && BT_HCI_UART
    help
      Power up a TI CC2564B as the H4 HCI controller and load TI's
      initialization script (third_party/ti_bt_sp), which it needs at every
      power up. The board provides BOARD_BT_HCI_UART_DEV (the STM32 USART
      the controller is on), BOARD_BT_HCI_USART, BOARD_BT_SHUTDOWN,
      BOARD_BT_CTS, BOARD_BT_HOST_RTS and BOARD_MCO1 for its 32 kHz slow
      clock.

config BT_CC2564_HCI_BAUD
    int "HCI baud rate"
    depends on BT_CONTROLLER_CC2564
    default 921600
    help
      Baud rate the controller is switched to after power up.

config BT_CC2564_SLEEP
    bool "CC2564 deep sleep (eHCILL)"
    depends on BT_CONTROLLER_CC2564
    help
      Let the controller deep sleep with TI's eHCILL protocol (SWRA288)
      and the host enter STOP mode meanwhile. Without it the controller
      never sleeps and STOP is blocked while Bluetooth runs.

config BT_CC2564_DIAG
    bool "Log HCI UART and bus counters"
    depends on BT_CONTROLLER_CC2564 && BT_HCI_UART_LEGACY
    imply I2C_STM32_STATS
    imply SPI_STM32_STATS
    help
      Count USART receive errors and bytes, and keep the uptime of the
      last HCI event and of the last completed ACL packet. They go into
      the "CC2564 stalled" line and, at most every 30 s and only when one
      changed, into a line of their own with the eHCILL counters and the
      I2C and SPI transfer counts. For finding why the controller stops
      answering; not for release images.

config BT_CC2564_SLEEP_NO_STOP
    bool "Keep the host out of STOP while the controller sleeps"
    depends on BT_CC2564_SLEEP
    help
      The controller still deep sleeps, but STOP stays blocked while
      Bluetooth runs, in case STOP stops MCO1, the controller's slow clock.
      For testing the two apart.
```

## drivers/display/Kconfig
```kconfig
# SPDX-FileCopyrightText: 2026 Core Devices LLC
# SPDX-License-Identifier: Apache-2.0

menuconfig DISPLAY
    bool "Display"
    help
      Display Drivers

if DISPLAY

config DISPLAY_SF32LB_LCDC
    bool "SiFli SF32LB LCD controller"
    default DT_HAS_SIFLI_SF32LB52_LCDC_ENABLED
    depends on SOC_SF32LB52
    select CLK
    select PANEL
    select PINCTRL
    select RESET
    help
      Support for the SiFli SF32LB LCD controller, driving a JDI
      memory-in-pixel panel.

config DISPLAY_SF32LB_LCDC_IRQ_PRIO
    int "Interrupt priority"
    default 5
    depends on DISPLAY_SF32LB_LCDC
    help
      Priority of the controller interrupt.

config DISPLAY_SHARP_LS013B7DH01
    bool "Sharp LS013B7DH01"
    default DT_HAS_SHARP_LS013B7DH01_ENABLED
    select PWM
    select SPI
    help
      Support for the Sharp LS013B7DH01 memory LCD.

config DISPLAY_ICE40LP_STM32
    bool "iCE40LP framebuffer FPGA (STM32)"
    depends on SOC_STM32F4
    default y if HAL_STM32_STM32F439
    select DMA
    select UZLIB
    help
      Support for the Pebble Time display, driven through an iCE40LP
      framebuffer FPGA on an STM32F4 SPI.

config DISPLAY_ICE40LP_ROUND
    bool "iCE40LP round panel"
    depends on DISPLAY_ICE40LP_STM32 && PLATFORM_ROUND
    help
      The FPGA drives the round panel of the Pebble Time Round: it takes
      rows of the packed round framebuffer, shifted by the factory display
      offsets, instead of columns.

config DISPLAY_ICE40LP_STM32_FAST_LINE
    bool "Optimize the line packing for speed"
    depends on DISPLAY_ICE40LP_STM32
    help
      Compile the function that packs each panel line, which runs in the
      DMA interrupt for every line of every frame, at -O3 instead of the
      firmware's -Os.

config DISPLAY_ICE40LP_STM32_BUSY_EDGE
    bool "Wake on the FPGA's BUSY edge before a frame"
    depends on DISPLAY_ICE40LP_STM32
    help
      Before a frame, sleep until BUSY's falling edge instead of polling
      BUSY with 1 ms sleeps. Without an edge within 40 ms it polls as
      before.

config DISPLAY_QEMU
    bool "QEMU Framebuffer Display"
    default DT_HAS_QEMU_PEBBLE_DISPLAY_ENABLED
    depends on SOC_QEMU_PEBBLE
    help
      Support for the QEMU framebuffer display peripheral.

config DISPLAY_SDL
    bool "SDL window"
    default y if SOC_POSIX
    select SDL
    help
      Display shown in an SDL window on the host of a native build.

if DISPLAY_SDL

config DISPLAY_SDL_WIDTH
    int "SDL display width"
    help
      Width of the SDL display, in pixels.

config DISPLAY_SDL_HEIGHT
    int "SDL display height"
    help
      Height of the SDL display, in pixels.

config DISPLAY_SDL_MONO
    bool "SDL display is monochrome"
    help
      The SDL display takes a 1-bit framebuffer, 8-bit color otherwise.

config DISPLAY_SDL_ROUND
    bool "SDL display is round"
    help
      The SDL display hides the pixels outside the circle of the
      LS013B7DD02 panel.

endif # DISPLAY_SDL

config DISPLAY_SHELL
    bool "Shell commands"
    default DRIVER_SHELL
    depends on SHELL
    help
      The display shell command, to show the display and turn its panel on
      or off.

module = DRIVER_DISPLAY
module-str = Display
source "subsys/logging/Kconfig.template.log_level"

endif # DISPLAY
```

## drivers/dma/Kconfig
```kconfig
# SPDX-FileCopyrightText: 2026 Core Devices LLC
# SPDX-License-Identifier: Apache-2.0

menuconfig DMA
    bool "DMA controllers"
    help
      DMA controller class (pbl/drivers/dma.h), selected by the drivers
      that move data through DMA channels.

if DMA

config DMA_SF32LB52
    bool "SiFli SF32LB52 DMA controller"
    default DT_HAS_SIFLI_SF32LB52_DMAC_ENABLED
    select CLK
    help
      The SF32LB52 HPSYS DMA controller (DMAC1).

config DMA_SF32LB52_IRQ_PRIO
    int "Interrupt priority"
    default 5
    depends on DMA_SF32LB52
    help
      Priority of the channel interrupts.

config DMA_STM32F4
    bool "ST STM32F4 DMA controller"
    default DT_HAS_ST_STM32_DMA_ENABLED
    select CLK
    help
      The STM32F4 DMA1 and DMA2 controllers.

config DMA_STM32F4_IRQ_PRIO
    int "Interrupt priority"
    default 14
    depends on DMA_STM32F4
    help
      Priority of the stream interrupts.

endif # DMA
```
